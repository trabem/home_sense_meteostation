## software/tests/hw_test/main/Kconfig.projbuild
```kconfig
menu "Meteostation"

    config METEO_MEASUREMENT_INTERVAL_SEC
        int "Periodic measurement interval (seconds)"
        default 300
        help
            Interval between periodic telemetry measurements. The device
            deep-sleeps between measurements.

    config METEO_I2C_FREQUENCY_HZ
        int "I2C bus frequency (Hz)"
        default 100000
        help
            100 kHz is the reliable default for the external sensor board
            cable. The main board supports up to 400 kHz (4.7 kOhm pull-ups).

    config METEO_I2C_TIMEOUT_MS
        int "I2C transfer timeout (ms)"
        default 100

    menu "Wi-Fi"

        config METEO_WIFI_CONNECT_TIMEOUT_MS
            int "Wi-Fi connect timeout (ms)"
            default 20000

        config METEO_WIFI_MAX_RETRIES
            int "Wi-Fi max connection retries"
            default 3
            help
                Bounded retry count. On failure the device logs a diagnostic
                error and goes back to deep sleep. No infinite retries.

        config METEO_PROV_TIMEOUT_MS
            int "BLE provisioning timeout (ms)"
            default 300000
            help
                How long BLE provisioning stays active waiting for credentials
                before the device gives up and goes back to sleep.

        config METEO_SNTP_SERVER
            string "SNTP server used after Wi-Fi connect"
            default "pool.ntp.org"

    endmenu

    menu "MQTT"

        config METEO_MQTT_URI
            string "MQTT broker URI"
            default "mqtts://broker.example.com:8883"
            help
                mqtts:// (TLS) is mandatory for production builds.

        config METEO_MQTT_USERNAME
            string "MQTT username (empty = anonymous)"
            default ""

        config METEO_MQTT_PASSWORD
            string "MQTT password/token (empty = none)"
            default ""

        config METEO_MQTT_QOS
            int "MQTT QoS for telemetry/events"
            range 0 2
            default 1

        config METEO_MQTT_CONNECT_TIMEOUT_MS
            int "MQTT connect timeout (ms)"
            default 15000

        config METEO_MQTT_PUBLISH_TIMEOUT_MS
            int "MQTT publish (QoS ack) timeout (ms)"
            default 10000

        config METEO_MQTT_TLS_SKIP_VERIFY
            bool "DEVELOPMENT ONLY: skip MQTT TLS certificate validation"
            default false
            help
                Never enable this in production builds.

        config METEO_MQTT_ROOT_TOPIC
            string "MQTT root topic"
            default "meteostation"

    endmenu

    menu "LoRa"

        config METEO_LORA_FREQUENCY_HZ
            int "LoRa frequency (Hz)"
            default 868100000
            help
                EU868 by default. E22-900M22S supports roughly 850-930 MHz.

        config METEO_LORA_TX_POWER_DBM
            int "LoRa TX power (dBm)"
            range -9 22
            default 14

        config METEO_LORA_SPREADING_FACTOR
            int "LoRa spreading factor (5-12)"
            range 5 12
            default 7

        choice METEO_LORA_BANDWIDTH
            prompt "LoRa bandwidth"
            default METEO_LORA_BANDWIDTH_125
            config METEO_LORA_BANDWIDTH_125
                bool "125 kHz"
            config METEO_LORA_BANDWIDTH_250
                bool "250 kHz"
            config METEO_LORA_BANDWIDTH_500
                bool "500 kHz"
        endchoice

        choice METEO_LORA_CODING_RATE
            prompt "LoRa coding rate"
            default METEO_LORA_CODING_RATE_4_5
            config METEO_LORA_CODING_RATE_4_5
                bool "4/5"
            config METEO_LORA_CODING_RATE_4_6
                bool "4/6"
            config METEO_LORA_CODING_RATE_4_7
                bool "4/7"
            config METEO_LORA_CODING_RATE_4_8
                bool "4/8"
        endchoice

        config METEO_LORA_TX_TIMEOUT_MS
            int "LoRa TX completion timeout (ms)"
            default 5000

        config METEO_LORA_BUSY_TIMEOUT_MS
            int "SX1262 BUSY wait timeout (ms)"
            default 500

    endmenu

    menu "Board"

        config METEO_J4_WIFI_ACTIVE_LEVEL
            int "J4 level that selects Wi-Fi transport (0 = closed/LOW, 1 = open/HIGH)"
            range 0 1
            default 0
            help
                Default mapping: J4 open (HIGH via 47k pull-up) -> LoRa,
                J4 closed (LOW) -> Wi-Fi. If the switch/cable is missing the
                device falls back to the low-power autonomous LoRa mode.

    endmenu

    choice METEO_LOG_LEVEL
        prompt "Application log level"
        default METEO_LOG_LEVEL_INFO
        config METEO_LOG_LEVEL_ERROR
            bool "Error"
        config METEO_LOG_LEVEL_WARN
            bool "Warning"
        config METEO_LOG_LEVEL_INFO
            bool "Info"
        config METEO_LOG_LEVEL_DEBUG
            bool "Debug"
    endchoice

endmenu
```

## software/tests/target_unit/main/Kconfig.projbuild
```kconfig
menu "Meteostation"

    config METEO_MEASUREMENT_INTERVAL_SEC
        int "Periodic measurement interval (seconds)"
        default 300
        help
            Interval between periodic telemetry measurements. The device
            deep-sleeps between measurements.

    config METEO_I2C_FREQUENCY_HZ
        int "I2C bus frequency (Hz)"
        default 100000
        help
            100 kHz is the reliable default for the external sensor board
            cable. The main board supports up to 400 kHz (4.7 kOhm pull-ups).

    config METEO_I2C_TIMEOUT_MS
        int "I2C transfer timeout (ms)"
        default 100

    menu "Wi-Fi"

        config METEO_WIFI_CONNECT_TIMEOUT_MS
            int "Wi-Fi connect timeout (ms)"
            default 20000

        config METEO_WIFI_MAX_RETRIES
            int "Wi-Fi max connection retries"
            default 3
            help
                Bounded retry count. On failure the device logs a diagnostic
                error and goes back to deep sleep. No infinite retries.

        config METEO_PROV_TIMEOUT_MS
            int "BLE provisioning timeout (ms)"
            default 300000
            help
                How long BLE provisioning stays active waiting for credentials
                before the device gives up and goes back to sleep.

        config METEO_SNTP_SERVER
            string "SNTP server used after Wi-Fi connect"
            default "pool.ntp.org"

    endmenu

    menu "MQTT"

        config METEO_MQTT_URI
            string "MQTT broker URI"
            default "mqtts://broker.example.com:8883"
            help
                mqtts:// (TLS) is mandatory for production builds.

        config METEO_MQTT_USERNAME
            string "MQTT username (empty = anonymous)"
            default ""

        config METEO_MQTT_PASSWORD
            string "MQTT password/token (empty = none)"
            default ""

        config METEO_MQTT_QOS
            int "MQTT QoS for telemetry/events"
            range 0 2
            default 1

        config METEO_MQTT_CONNECT_TIMEOUT_MS
            int "MQTT connect timeout (ms)"
            default 15000

        config METEO_MQTT_PUBLISH_TIMEOUT_MS
            int "MQTT publish (QoS ack) timeout (ms)"
            default 10000

        config METEO_MQTT_TLS_SKIP_VERIFY
            bool "DEVELOPMENT ONLY: skip MQTT TLS certificate validation"
            default false
            help
                Never enable this in production builds.

        config METEO_MQTT_ROOT_TOPIC
            string "MQTT root topic"
            default "meteostation"

    endmenu

    menu "LoRa"

        config METEO_LORA_FREQUENCY_HZ
            int "LoRa frequency (Hz)"
            default 868100000
            help
                EU868 by default. E22-900M22S supports roughly 850-930 MHz.

        config METEO_LORA_TX_POWER_DBM
            int "LoRa TX power (dBm)"
            range -9 22
            default 14

        config METEO_LORA_SPREADING_FACTOR
            int "LoRa spreading factor (5-12)"
            range 5 12
            default 7

        choice METEO_LORA_BANDWIDTH
            prompt "LoRa bandwidth"
            default METEO_LORA_BANDWIDTH_125
            config METEO_LORA_BANDWIDTH_125
                bool "125 kHz"
            config METEO_LORA_BANDWIDTH_250
                bool "250 kHz"
            config METEO_LORA_BANDWIDTH_500
                bool "500 kHz"
        endchoice

        choice METEO_LORA_CODING_RATE
            prompt "LoRa coding rate"
            default METEO_LORA_CODING_RATE_4_5
            config METEO_LORA_CODING_RATE_4_5
                bool "4/5"
            config METEO_LORA_CODING_RATE_4_6
                bool "4/6"
            config METEO_LORA_CODING_RATE_4_7
                bool "4/7"
            config METEO_LORA_CODING_RATE_4_8
                bool "4/8"
        endchoice

        config METEO_LORA_TX_TIMEOUT_MS
            int "LoRa TX completion timeout (ms)"
            default 5000

        config METEO_LORA_BUSY_TIMEOUT_MS
            int "SX1262 BUSY wait timeout (ms)"
            default 500

    endmenu

    menu "Board"

        choice METEO_TRANSPORT_OVERRIDE
            prompt "Transport selection source"
            default METEO_TRANSPORT_FROM_J4
            help
                Production: J4 switch. The FORCE options exist only for
                development/bring-up on boards without the PCA9536.

            config METEO_TRANSPORT_FROM_J4
                bool "From J4 switch (default)"
            config METEO_TRANSPORT_FORCE_WIFI
                bool "Force Wi-Fi (development)"
            config METEO_TRANSPORT_FORCE_LORA
                bool "Force LoRa (development)"
        endchoice

        config METEO_PROV_LOG_POP
            bool "DEVELOPMENT ONLY: log BLE provisioning proof-of-possession"
            default false
            help
                Prints the per-device PoP to the console so it can be entered
                in the provisioning app during bring-up. Never enable in
                production builds.

        config METEO_USB_CONTINUOUS_MODE
            bool "Stay awake while USB-powered (no deep sleep)"
            default true
            help
                When the TPS2121 reports USB as the active power source, the
                device skips deep sleep and instead runs measurement cycles on
                a timer. Keeps the USB port (flashing/monitor) and Wi-Fi
                provisioning available. Battery-powered behaviour is unchanged.

        config METEO_USB_DETECT_USJ
            bool "Detect USB host via USB-Serial-JTAG enumeration"
            default true
            help
                Boards without a wired power-source status line (e.g. ESP32-C3
                Super Mini) detect a USB connection by host enumeration of the
                native USB-Serial-JTAG peripheral (GPIO18/19). On the main PCB
                the TPS2121 status line is authoritative; this is a fallback.

        config METEO_FORCE_CONTINUOUS
            bool "DEVELOPMENT ONLY: always run continuous mode (no deep sleep)"
            default false
            help
                Useful on bring-up boards where CHARGE_SOURCE_STATUS_OUT is
                not wired. Never enable in production.

        config METEO_J4_WIFI_ACTIVE_LEVEL
            int "J4 level that selects Wi-Fi transport (0 = closed/LOW, 1 = open/HIGH)"
            range 0 1
            default 0
            help
                Default mapping: J4 open (HIGH via 47k pull-up) -> LoRa,
                J4 closed (LOW) -> Wi-Fi. If the switch/cable is missing the
                device falls back to the low-power autonomous LoRa mode.

    endmenu

    choice METEO_LOG_LEVEL
        prompt "Application log level"
        default METEO_LOG_LEVEL_INFO
        config METEO_LOG_LEVEL_ERROR
            bool "Error"
        config METEO_LOG_LEVEL_WARN
            bool "Warning"
        config METEO_LOG_LEVEL_INFO
            bool "Info"
        config METEO_LOG_LEVEL_DEBUG
            bool "Debug"
    endchoice

endmenu
```
